## main/Kconfig.projbuild
```kconfig
menu "Smarthome module Configuration"

config CLOCK_TIMEZONE
    string "Clock timezone"
	default "CET-1CEST-2,M3.5.0/02:00:00,M10.5.0/03:00:00"
	help
		Cleck timezone to display time. String describes timezone and winter/summer time.
		
		See explanation: https://www.gnu.org/software/libc/manual/html_node/TZ-Variable.html
		
config WIFI_SSID
    string "WiFi SSID"
	default "myssid"
	help
		SSID (network name) for the example to connect to.

config WIFI_PASSWORD
    string "WiFi Password"
	default "myssid"
	help
		WiFi password (WPA or WPA2) for the example to use.

		Can be left blank if the network has no security set.

config MQTT_HOST
    string "MQTT broker host"
	default "broker.lan"

config MQTT_PORT
    string "MQTT broker port"
	default "1883"

config MQTT_USER
    string "MQTT broker user"
	default "user"

config MQTT_PASS
    string "MQTT broker password"
	default "pass"

endmenu
```
